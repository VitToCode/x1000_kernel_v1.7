## arch/mips/configs/doss_wb38_defconfig
```kconfig
CONFIG_MACH_XBURST=y
CONFIG_SOC_X1000=y
CONFIG_PRODUCT_X1000_CANNA=y
CONFIG_EXTAL_CLOCK=24
# CONFIG_PM_POWERDOWN_P0 is not set
# CONFIG_RESET_KEEP_POWER is not set
# CONFIG_JZRISC_PEP is not set
# CONFIG_ARM_ELF_SUPPORT is not set
CONFIG_FORCE_MAX_ZONEORDER=15
CONFIG_HIGH_RES_TIMERS=y
CONFIG_HZ_100=y
CONFIG_PREEMPT=y
# CONFIG_SECCOMP is not set
CONFIG_EXPERIMENTAL=y
CONFIG_CROSS_COMPILE="mips-linux-gnu-"
# CONFIG_SWAP is not set
CONFIG_SYSVIPC=y
CONFIG_LOG_BUF_SHIFT=14
CONFIG_CGROUPS=y
CONFIG_RESOURCE_COUNTERS=y
CONFIG_CGROUP_MEM_RES_CTLR=y
CONFIG_PANIC_TIMEOUT=3
# CONFIG_SYSCTL_SYSCALL is not set
# CONFIG_KALLSYMS is not set
# CONFIG_ELF_CORE is not set
# CONFIG_PCSPKR_PLATFORM is not set
# CONFIG_BASE_FULL is not set
# CONFIG_EPOLL is not set
# CONFIG_SIGNALFD is not set
# CONFIG_TIMERFD is not set
# CONFIG_AIO is not set
CONFIG_EMBEDDED=y
# CONFIG_VM_EVENT_COUNTERS is not set
# CONFIG_SLUB_DEBUG is not set
CONFIG_FINER_KMALLOC=y
CONFIG_SLUB_FEWER_OBJECTS=y
CONFIG_MODULES=y
# CONFIG_BLK_DEV_BSG is not set
CONFIG_PM_RUNTIME=y
CONFIG_NET=y
CONFIG_PACKET=y
CONFIG_UNIX=y
CONFIG_INET=y
CONFIG_IP_MULTICAST=y
CONFIG_IP_PNP=y
CONFIG_IP_PNP_DHCP=y
CONFIG_IP_PNP_BOOTP=y
# CONFIG_INET_XFRM_MODE_TRANSPORT is not set
# CONFIG_INET_XFRM_MODE_TUNNEL is not set
# CONFIG_INET_XFRM_MODE_BEET is not set
# CONFIG_INET_LRO is not set
# CONFIG_IPV6 is not set
# CONFIG_ANDROID_PARANOID_NETWORK is not set
# CONFIG_NET_ACTIVITY_STATS is not set
CONFIG_NETWORK_PHY_TIMESTAMPING=y
CONFIG_NETFILTER=y
CONFIG_NETFILTER_TPROXY=y
CONFIG_NETFILTER_XT_SET=y
CONFIG_NETFILTER_XT_TARGET_NFLOG=y
CONFIG_NETFILTER_XT_TARGET_NFQUEUE=y
CONFIG_NETFILTER_XT_TARGET_TPROXY=y
CONFIG_NETFILTER_XT_MATCH_QUOTA=y
CONFIG_NETFILTER_XT_MATCH_QUOTA2=y
CONFIG_NETFILTER_XT_MATCH_QUOTA2_LOG=y
CONFIG_NETFILTER_XT_MATCH_SOCKET=y
CONFIG_IP_SET=y
CONFIG_IP_SET_BITMAP_IPMAC=y
CONFIG_IP_NF_IPTABLES=y
CONFIG_IP_NF_FILTER=y
CONFIG_IP_NF_MANGLE=y
CONFIG_IP_NF_RAW=y
CONFIG_WIRELESS_EXT=y
CONFIG_WEXT_PRIV=y
CONFIG_CFG80211=y
CONFIG_LIB80211=y
CONFIG_RFKILL=y
CONFIG_MTD=y
CONFIG_MTD_CMDLINE_PARTS=y
CONFIG_MTD_CHAR=y
CONFIG_MTD_BLOCK=y
CONFIG_JZ_SFC=y
CONFIG_SFC_DMA=y
CONFIG_SPI_QUAD=y
CONFIG_MTD_JZ_SFC_NORFLASH=y
CONFIG_MISC_DEVICES=y
# CONFIG_ANDROID_PMEM is not set
CONFIG_BCM_AP6212_RFKILL=y
# CONFIG_JZ_DMMU is not set
CONFIG_JZ_PWM_BIT4=y
CONFIG_SCSI=y
# CONFIG_SCSI_PROC_FS is not set
CONFIG_BLK_DEV_SD=y
# CONFIG_SCSI_LOWLEVEL is not set
CONFIG_NETDEVICES=y
# CONFIG_NETDEV_1000 is not set
# CONFIG_NETDEV_10000 is not set
CONFIG_BCMDHD_1_141_66=y
CONFIG_BCM4343=y
CONFIG_BCMDHD_1_141_66_FW_PATH="/lib/firmware/"
CONFIG_BCMDHD_1_141_66_NVRAM_PATH="/lib/firmware/"
# CONFIG_INPUT_MOUSEDEV is not set
CONFIG_INPUT_EVDEV=y
# CONFIG_KEYBOARD_ATKBD is not set
CONFIG_KEYBOARD_JZGPIO=y
CONFIG_DOSS_WB38_INDEPENDENT_KEY=y
# CONFIG_INPUT_MOUSE is not set
# CONFIG_SERIO is not set
# CONFIG_VT is not set
CONFIG_DEVPTS_MULTIPLE_INSTANCES=y
# CONFIG_LEGACY_PTYS is not set
CONFIG_MTD_NV_WR=y
# CONFIG_DEVKMEM is not set
CONFIG_SERIAL_JZ47XX_UART=y
CONFIG_SERIAL_JZ47XX_CONSOLE=y
CONFIG_SERIAL_JZ47XX_UART0=y
CONFIG_SERIAL_JZ47XX_UART2=y
CONFIG_SERIAL_JZ47XX_UART2_PC=y
# CONFIG_HW_RANDOM is not set
CONFIG_I2C=y
CONFIG_I2C_GPIO=y
CONFIG_I2C_V12_JZ=y
CONFIG_SOFT_I2C1_GPIO_V12_JZ=y
# CONFIG_HWMON is not set
# CONFIG_MFD_SUPPORT is not set
CONFIG_REGULATOR=y
CONFIG_REGULATOR_FIXED_VOLTAGE=y
CONFIG_FB=y
CONFIG_BACKLIGHT_LCD_SUPPORT=y
CONFIG_LCD_CLASS_DEVICE=y
CONFIG_LCD_FRD20024N=y
CONFIG_SLCDC_CONTINUA=y
CONFIG_BACKLIGHT_CLASS_DEVICE=y
# CONFIG_BACKLIGHT_GENERIC is not set
CONFIG_BACKLIGHT_PWM=y
# CONFIG_JZ_IPU is not set
CONFIG_FB_JZ_V13=y
CONFIG_LCD_V13_SLCD_8BIT=y
CONFIG_LOGO_BMP=y
CONFIG_ONE_FRAME_BUFFERS=y
# CONFIG_JZ_VPU is not set
CONFIG_SOUND=y
CONFIG_SOUND_PRIME=y
CONFIG_SOUND_JZ_I2S_V13=y
CONFIG_JZ_EXTERNAL_CODEC_V13=y
CONFIG_AKM4951_EXTERNAL_CODEC=y
CONFIG_AKM4951_AEC_MODE=y
CONFIG_SOUND_JZ_PCM_V12=y
CONFIG_SOUND_JZ_DMIC_V12=y
CONFIG_JZ_DMIC0=y
CONFIG_JZ_DMIC1=y
CONFIG_SOUND_XBURST_DETECT=y
# CONFIG_HID_SUPPORT is not set
CONFIG_USB=y
CONFIG_USB_SUSPEND=y
# CONFIG_USB_OTG_WHITELIST is not set
CONFIG_USB_DWC2=y
CONFIG_USB_STORAGE=y
CONFIG_USB_GADGET=y
CONFIG_USB_GADGET_DWC2=y
CONFIG_USB_G_ANDROID=y
CONFIG_MMC=y
CONFIG_JZMMC_V12=y
CONFIG_JZMMC_V12_MMC0=y
CONFIG_MMC0_MAX_FREQ=50000000
CONFIG_JZMMC_V12_MMC1=y
CONFIG_SWITCH=y
CONFIG_RTC_CLASS=y
# CONFIG_RTC_INTF_SYSFS is not set
# CONFIG_RTC_INTF_PROC is not set
# CONFIG_RTC_INTF_ALARM is not set
CONFIG_RTC_DRV_JZ=y
CONFIG_DMADEVICES=y
CONFIG_XBURST_DMAC_V13=y
CONFIG_EXT4_FS=y
# CONFIG_DNOTIFY is not set
CONFIG_MSDOS_FS=y
CONFIG_VFAT_FS=y
CONFIG_FAT_DEFAULT_CODEPAGE=936
CONFIG_FAT_DEFAULT_IOCHARSET="utf8"
# CONFIG_PROC_PAGE_MONITOR is not set
CONFIG_TMPFS=y
CONFIG_JFFS2_FS=y
CONFIG_JFFS2_COMPRESSION_OPTIONS=y
# CONFIG_JFFS2_ZLIB is not set
# CONFIG_JFFS2_RTIME is not set
CONFIG_CRAMFS=y
CONFIG_NFS_FS=y
CONFIG_NFS_V3=y
CONFIG_ROOT_NFS=y
CONFIG_NLS_DEFAULT="cp936"
CONFIG_NLS_CODEPAGE_936=y
CONFIG_NLS_ASCII=y
CONFIG_NLS_ISO8859_1=y
CONFIG_NLS_UTF8=y
CONFIG_PRINTK_TIME=y
# CONFIG_ENABLE_WARN_DEPRECATED is not set
# CONFIG_ENABLE_MUST_CHECK is not set
# CONFIG_STACKTRACE is not set
# CONFIG_RCU_CPU_STALL_VERBOSE is not set
# CONFIG_EARLY_PRINTK is not set
```

## arch/mips/xburst/Kconfig
```kconfig
choice
	prompt "SOC type"
	depends on MACH_XBURST
	default SOC_4780

config SOC_4780
	bool "4780"
	select JZRISC
	select TRACEPOINTS
	select SYS_SUPPORTS_HIGHMEM
	select NR_CPUS_DEFAULT_2
	select SYS_SUPPORTS_SMP
	select GENERIC_CLOCKEVENTS_BROADCAST

endchoice

config JZRISC
	bool
	select ARCH_REQUIRE_GPIOLIB
	select IRQ_CPU
	select DMA_NONCOHERENT
	select SYS_HAS_CPU_MIPS32_R1
	select SYS_SUPPORTS_32BIT_KERNEL
	select SYS_SUPPORTS_LITTLE_ENDIAN

config SOC_VER
	int
	default "80" if SOC_4780

if SOC_4780
source "arch/mips/xburst/soc-4780/Kconfig"
endif

config EXTAL_CLOCK
	depends on MACH_XBURST 
	int "extal clock in MHz"
	default 12

config FPGA_TEST
	depends on MACH_XBURST 
	bool "FPGA_TEST"
	default n

config PM_POWERDOWN_P0
	depends on MACH_XBURST
	bool "power down xburst cpu core when sleep"
	default y

config HIBERNATE_RESET
	depends on MACH_XBURST
	bool "use hibernate reset instead watch dog reset"
	default n

config TRAPS_USE_TCSM
	depends on MACH_XBURST
	bool "move irq handler to tcsm"
	default n

config EARLYSUSPEND_CPU
	depends on EARLYSUSPEND
	bool "suspend non-boot cpu when enter early suspend"
	default n

config CPUFREQ_CHANGE_VCORE
	depends on CPU_FREQ
	bool "change vcore voltage when cpu frequency has changed"
	default n
```

## arch/mips/xburst/soc-4775/Kconfig
```kconfig
choice
	prompt "Board type"
	depends on SOC_4775
	default BOARD_4775_TEST

config BOARD_4775_ORION
        bool "ORION"

config BOARD_4775_MENSA
        bool "MENSA"

config BOARD_4775_COMET
        bool "COMET"

config BOARD_4775_CONE
	bool "CONE"

config BOARD_4775_CONE_V1_2
        bool "CONE_V1_2"	

config BOARD_4775_HSUN
	bool "HSUN"

endchoice

config BOARD_NAME
	string
	default "orion" if BOARD_4775_ORION
	default "mensa" if BOARD_4775_MENSA
	default "comet" if BOARD_4775_COMET
	default "cone" if BOARD_4775_CONE
	default "cone_v1_2" if BOARD_4775_CONE_V1_2
	default "hsun" if BOARD_4775_HSUN
```

## arch/mips/xburst/soc-4775/chip-m150/Kconfig
```kconfig
choice
	prompt "Board type"
	depends on SOC_4775
	default PRODUCT_DEVELOP

config PRODUCT_DEVELOP
    bool "DEVELOP"

endchoice

config PRODUCT_NAME
string
	default "halley" if PRODUCT_DEVELOP


if PRODUCT_DEVELOP
source "arch/mips/xburst/soc-4775/chip-m150/halley/Kconfig"
endif
```

## arch/mips/xburst/soc-4775/chip-m150/halley/Kconfig
```kconfig
choice
prompt "BOARD type"
depends on PRODUCT_DEVELOP
default BOARD_HALLEY_V10

config BOARD_HALLEY_V10
bool "board halley v10"
depends on PRODUCT_DEVELOP

endchoice

config BOARD_NAME
string
default "halley_v10" if BOARD_HALLEY_V10
```

## arch/mips/xburst/soc-4780/Kconfig
```kconfig
choice
	prompt "Board type"
	depends on SOC_4780
	default BOARD_TEST

config BOARD_TEST
        bool "TEST"

config BOARD_PISCES
        bool "PISCES"

config BOARD_GIANT
        bool "Giant"

config BOARD_WARRIOR
        bool "Warrior"

config BOARD_WARRIOR_V_1_1
        bool "Warrior v1.1"

config BOARD_TROOPER
        bool "Trooper"

config BOARD_CAPTAIN
        bool "Captain"

config BOARD_M80
        bool "M80"

config BOARD_JI8070A
        bool "JI8070A"

config BOARD_JI8070B
	bool "JI8070B"

config BOARD_M80701
		bool "M80701"
		
config BOARD_HDMI_80
		bool "HDMI_80"

config BOARD_NPM801
		bool "NPM801"

config BOARD_I88
		bool "I88"

config BOARD_GRUS
		bool "Grus"

endchoice


  
config  Q8
	 bool "Ingenic JZ4780 for the diffrence bettwen  JI8070A and Q8"
	 depends on  BOARD_JI8070A 

config  JI8070A
	 bool "Ingenic JZ4780 for the diffrence bettwen  JI8070A and JI8070B"
	 depends on  BOARD_JI8070A


config BOARD_NAME
	string
	default "pisces" if BOARD_PISCES
	default "test" if BOARD_TEST
	default "Giant" if BOARD_GIANT
	default "Warrior" if BOARD_WARRIOR
	default "Warrior" if BOARD_WARRIOR_V_1_1
	default "Trooper" if BOARD_TROOPER
	default "Captain" if BOARD_CAPTAIN
	default "HDMI_80" if BOARD_HDMI_80
	default "M80" if BOARD_M80
	default "JI8070A" if BOARD_JI8070A
	default "ji8070B" if BOARD_JI8070B
	default "M80701" if BOARD_M80701
	default "NPM801" if BOARD_NPM801
	default "I88" if BOARD_I88
	default "Grus" if BOARD_GRUS
```

## arch/mips/xburst/soc-m200/Kconfig
```kconfig
choice
	prompt "PRODUCT type"
	depends on SOC_M200
	default PRODUCT_DEVELOP

config BOARD_4785_FPGA
       bool "FPGA"

config PRODUCT_DEVELOP
       bool "DEVELOP"

config BOARD_DORADO_V20
       bool "board dorado v20"
       depends on PRODUCT_DEVELOP

config BOARD_DORADO_V21
       bool "board dorado v21"
       depends on PRODUCT_DEVELOP

config BOARD_DORADO_V30
       bool "board dorado v30"
       depends on PRODUCT_DEVELOP

config BOARD_FORNAX
       bool "FORNAX"
endchoice

config PRODUCT_NAME
	string
	default "fpga" if BOARD_4785_FPGA
	default "dorado" if PRODUCT_DEVELOP
	default "fornax" if BOARD_FORNAX

config BOARD_NAME
	string
	default "dorado_v20" if BOARD_DORADO_V20

config BOARD_NAME
	string
	default "dorado_v21" if BOARD_DORADO_V21

config BOARD_NAME
	string
	default "dorado_v30" if BOARD_DORADO_V30
```

## arch/mips/xburst/soc-m200/board/rvms/Kconfig
```kconfig
choice
	prompt "BOARD type"
	depends on PRODUCT_RVMS
	default BOARD_FORNAX

config BOARD_FORNAX
       bool "board fornax"
       depends on PRODUCT_RVMS
config BOARD_PAWSCAN
       bool "board pawscan"
       depends on PRODUCT_RVMS
endchoice

config BOARD_NAME
	string
	default "fornax" if BOARD_FORNAX
	default "pawscan" if BOARD_PAWSCAN
```

## arch/mips/xburst/soc-x1000/Kconfig
```kconfig
choice
	prompt "Chip type"
	depends on SOC_X1000
	default CHIP_X1000

config CHIP_X1000
       bool "chip-x1000"
       select TRACEPOINTS
       select SYS_SUPPORTS_HIGHMEM
       select GENERIC_CLOCKEVENTS_BROADCAST

endchoice

choice
	prompt "board timer select sys-ost or tcu"
	depends on CHIP_X1000
	default TIMER_SYS_OST
config TIMER_SYS_OST
	bool "sys-ost"
config TIMER_TCU
	bool "tcu"
endchoice

#menu "modules gpios"
#source "arch/mips/xburst/soc-x1000/common/Kconfig"
#endmenu

if CHIP_X1000
source "arch/mips/xburst/soc-x1000/chip-x1000/Kconfig"
endif
```

## arch/mips/xburst/soc-x1000/chip-x1000/Kconfig
```kconfig
choice
	prompt "Board type"
	depends on SOC_X1000
	default PRODUCT_X1000_PHOENIX

config  PRODUCT_X1000_PHOENIX
    bool "product x1000 phoenix"

config  PRODUCT_X1000_CANNA
    bool "product x1000 canna"

config  PRODUCT_X1000_ASLMOM
    bool "product x1000 aslmom"

config  PRODUCT_X1000_YOUTH
    bool "product x1000 youth"
endchoice

if PRODUCT_X1000_PHOENIX
config PRODUCT_NAME
string
default "phoenix"
source "arch/mips/xburst/soc-x1000/chip-x1000/phoenix/Kconfig"
endif

if PRODUCT_X1000_CANNA
config PRODUCT_NAME
string
default "canna"
source "arch/mips/xburst/soc-x1000/chip-x1000/canna/Kconfig"
endif

if PRODUCT_X1000_ASLMOM
config PRODUCT_NAME
string
default "aslmom"
source "arch/mips/xburst/soc-x1000/chip-x1000/aslmom/Kconfig"
endif

if PRODUCT_X1000_YOUTH
config PRODUCT_NAME
string
default "youth"
source "arch/mips/xburst/soc-x1000/chip-x1000/youth/Kconfig"
endif
```

## arch/mips/xburst/soc-x1000/chip-x1000/doss/Kconfig
```kconfig
choice
prompt "BOARD version"
depends on PRODUCT_X1000_DOSS
default BOARD_X1000_DOSS_V10

config BOARD_X1000_DOSS_V10
bool "board x1000 doss v10"
depends on PRODUCT_X1000_DOSS

endchoice

config BOARD_NAME
string
default "doss_v10" if BOARD_X1000_DOSS_V10
```

## arch/mips/xburst/soc-x1000/common/Kconfig
```kconfig
menuconfig UART1_GPIO
	tristate "uart1 gpio"
	depends on SOC_X1000
	default n
	help
	  If you want use uart1, you should say Y here and
	  also to your specific host gpio pin.

if UART1_GPIO
choice
	prompt "uart1 gpio pa or pd"
	depends on UART1_GPIO
	default SERIAL_JZ47XX_UART1_PA

config SERIAL_JZ47XX_UART1_PA
	bool "uart1_pa"
	select SERIAL_JZ47XX_UART1
config SERIAL_JZ47XX_UART1_PD
	bool "uart1_pd"
	select SERIAL_JZ47XX_UART1
endchoice
endif

menuconfig UART2_GPIO
	tristate "uart2 gpio"
	depends on SOC_X1000
	default n
	help
	  If you want use uart2, you should say Y here and
	  also to your specific host gpio pin.

if UART2_GPIO
choice
	prompt "uart2 gpio pa or pc or pd"
	depends on UART2_GPIO
	default SERIAL_JZ47XX_UART2_PD

config SERIAL_JZ47XX_UART2_PA
	bool "uart2_pa"
	select SERIAL_JZ47XX_UART2
config SERIAL_JZ47XX_UART2_PC
	bool "uart2_pc"
	select SERIAL_JZ47XX_UART2
config SERIAL_JZ47XX_UART2_PD
	bool "uart2_pd"
	select SERIAL_JZ47XX_UART2
endchoice
endif

menuconfig SPI0_GPIO
	tristate "spi0 gpio"
	depends on SOC_X1000
	default n
	help
	  If you want use SPI0, you should say Y here and
	  also to your specific host gpio pin.

if SPI0_GPIO
choice
	prompt "spi0 gpio pa or pd"
	depends on SPI0_GPIO
	default SPI0_JZ47XX_PA
config SPI0_JZ47XX_PA
	bool "spi0_pa"
	select SPI0_JZ47XX
config SPI0_JZ47XX_PD
	bool "spi0_pd"
	select SPI0_JZ47XX
endchoice
endif

menuconfig I2C1_GPIO
	tristate "i2c1 gpio"
	depends on SOC_X1000
	default n
	help
	  If you want use i2c1, you should say Y here and
	  also to your specific host gpio pin.

if I2C1_GPIO
choice
	prompt "i2c1 gpio pa or pd"
	depends on I2C1_GPIO
	default I2C1_V12_PA
config I2C1_V12_PA
	bool "i2c1_pa"
	select I2C1_V12_JZ
config I2C1_V12_PC
	bool "i2c1_pc"
	select I2C1_V12_JZ
endchoice
endif
```

## drivers/misc/jz_cim/Kconfig
```kconfig
config JZ_CIM
	bool "ingenic camera interface module"
	depends on MACH_XBURST
	default y

config OV3640
	bool "ov3640 camera sensor"
	depends on JZ_CIM
	default n

config FAKE
	bool "fake camera sensor only for test"
	depends on JZ_CIM
	default n

config FAKE_NR
	int "fake camera sensor number"
	depends on FAKE
	default 2
```
