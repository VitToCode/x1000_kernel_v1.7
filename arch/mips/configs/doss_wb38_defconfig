## drivers/nand/Kconfig
```kconfig
#
# NAND subsystem configuration
#

menuconfig NAND
	tristate "NAND support"
	depends on HAS_IOMEM
	---help---
	  If you want NAND support, you should say Y here and also to the
	  specific driver for your bus adapter(s) below.


if NAND

config NAND_JZ4780
	bool "Ingenic JZ4780 Nand Function Setting"
	depends on SOC_4780 && !MMC0_JZ4780_PA_4BIT && !MMC0_JZ4780_PA_8BIT &&  !MMC0_JZ4780_PA_4BIT_RESET && ! MMC0_JZ4780_PA_8BIT_RESET
        select NAND_JZ4780_COMMON
	help
	  This selects the NAND function for JZ4780 support. 
          If you have an JZ4780 platform with a NAND slot,
          say Y here.

	  If unsure, say N.
          NOTE: If GPIOA is selected by MSC0, Nand function
          Setting will be hiding.

config NAND_JZ4780_COMMON
	bool "NAND_JZ4780_COMMON"
	depends on NAND_JZ4780
        help
	  If you want set NAND function. This selects default 
          is y.

comment "nand function cs selects"
        depends on NAND_JZ4780_COMMON
config NAND_JZ4780_CS1
	bool "NAND_JZ4780_CS1"
        depends on NAND_JZ4780_COMMON
        default y
config NAND_JZ4780_CS2
	bool "NAND_JZ4780_CS2"
        depends on NAND_JZ4780_COMMON

config NAND_JZ4780_CS3
	bool "NAND_JZ4780_CS3"
        depends on NAND_JZ4780_COMMON

config NAND_JZ4780_CS4
	bool "NAND_JZ4780_CS4"
        depends on NAND_JZ4780_COMMON

config NAND_JZ4780_CS5
	bool "NAND_JZ4780_CS5"
        depends on NAND_JZ4780_COMMON

config NAND_JZ4780_CS6
	bool "NAND_JZ4780_CS6"
        depends on NAND_JZ4780_COMMON

endif # NAND
```

## drivers/usb/dwc/Kconfig
```kconfig
config USB_DWC_OTG
	tristate 'Synopsys otg 2.0 support'
	depends on SOC_4780
	select DWC_LM_INTERFACE
	help
	  Say Y here to select Synopsys otg.
choice
	prompt "Synopsys otg mode"
	depends on USB_DWC_OTG

config USB_DWC_OTG_DUAL
	bool "both host and device function"
	select USB_DWC_PERIPHERAL

config USB_DWC_DEV_ONLY
	bool "device function"
	select USB_DWC_PERIPHERAL

config USB_DWC_HOST_ONLY
	bool "host function"

endchoice

config USB_DWC_PERIPHERAL
	bool
	depends on (USB_DWC_OTG_DUAL || USB_DWC_DEV_ONLY)

config DWC_LM_INTERFACE
	bool
	depends on USB_DWC_OTG
```

## drivers/usb/dwc2/Kconfig
```kconfig
config USB_DWC2
	tristate "DesignWare Core USB 2.0 Hi-Speed On-The-Go(OTG)"
	depends on (USB && USB_GADGET)
	help
	  Say Y or M here if your system has a Dual Role SuperSpeed
	  USB controller based on the DesignWare USB2.0 IP Core.

	  If you choose to build this driver is a dynamically linked
	  module, the module will be called dwc2.ko.

if USB_DWC2

config USB_DWC2_DEBUG
	bool "Enable Debugging(dev_dbg) Messages"
	help
	  Say Y here to enable debugging messages on DWC2 Driver.

config USB_DWC2_VERBOSE
	bool "Enable Verbose Debugging(dev_vdbg) Messages"
	depends on USB_DWC2_DEBUG
	help
	  Say Y here to enable verbose debugging messages on DWC2 Driver.

config USB_DWC2_VERBOSE_VERBOSE
	bool "Enable Very Verbose Debugging Messagers"
	default y
	help
	  enable debugging messages for developer debug, these debugging messages
          are switchable write 1 to file under /sys/module/dwc2/parameters/,
          the default value is 0, so you can always say Y here and won't get boring.

config USB_DWC2_REQ_TRACER
	bool "Enable tracing of usb_requests"
	help
	  Say Y here to enable tracing of enqueue/dequeue/complete
	  of struct usb_request for all EPs

endif
```

## sound/oss/jzsound/Kconfig
```kconfig
menuconfig SOUND_OSS_XBURST
	bool "Open Sound System of xburst"
	#depends on SOUND_OSS_CORE
	default y
	help
	  Say 'Y' to enable Open Sound System drivers of xburst.


if SOUND_OSS_XBURST

menu "sound DSP devices of xburst"

config SOUND_I2S0_JZ47XX
	bool "Jz On-Chip I2S0 driver"
	help
		Say 'Y' to enable On-Chip i2s0

config SOUND_I2S1_JZ47XX
	bool "Jz On-Chip I2S1 driver"
	help
		Say 'Y' to enable On-Chip i2s1

config SOUND_PCM0_JZ47XX
	bool "Jz On-Chip PCM0 driver"
	help
		Say 'Y' to enable On-Chip pcm0

config SOUND_PCM1_JZ47XX
	bool "Jz On-Chip PCM1 driver"
	help
		Say 'Y' to enable On-Chip pcm1

endmenu

menuconfig JZ_INTERNAL_CODEC

	bool "xburst internal coedc"
	depends on SOUND_I2S0_JZ47XX
	help
		Say "Y" to select xburst internal codec.

if JZ_INTERNAL_CODEC

	config JZ4780_INTERNAL_CODEC
	bool "jz4780 internal codec"
	help
		Say "Y" to enable jz4780 internal codec.
endif #JZ_INTERNAL_CODEC

menuconfig JZ_EXTERNAL_CODEC
	bool "xburst external codec"
	help
		Say	"Y" to setect xburst external codec

if JZ_EXTERNAL_CODEC

	#external codec

endif #JZ_EXTERNAL_CODEC


menu "sound MIXER devices of xburst"

config SOUND_MIXER0_JZ47XX
	bool "Jz virtual mixer0 driver"
	help
		Say 'Y' to enable virtual mixer0

endmenu


menuconfig SOUND_XBURST_DETECT
	bool "sound detect device of xburst"
	default n
	help
	  Say 'Y' to enable sound detect devices support.

if SOUND_XBURST_DETECT

menu "JZ headset detect"

config JZ_HP0_DETECT
	bool "jz4780 headphone detect 0"
	depends on SOUND_I2S0_JZ47XX
	help
	Say "Y" to enable internal codec headphone detect.

config JZ_HP1_DETECT
	bool "jz4780 headphone detect 1"
	depends on SOUND_I2S1_JZ47XX

endmenu

menu "JZ dock detect"

endmenu

endif #SOUND_XBURST_DETECT

menuconfig SOUND_XBURST_DEBUG
	bool "sound debug device of xburst"
	default n
	help
	  Say 'Y' to enable sound debug devices support.

endif #SOUND_OSS_XBURST
```

## sound/soc/ingenic/Kconfig
```kconfig
menuconfig SND_ASOC_INGENIC
	tristate "ASoC support for Ingenic"
	depends on JZRISC && SND_SOC
	help
		Say 'Y' to enable Alsa drivers of xburst.

if SND_ASOC_INGENIC

config SND_ASOC_JZ_AIC
	tristate

config JZ_AIC_MASTER
	tristate

config SND_ASOC_JZ_INCODEC
	tristate

config SND_ASOC_JZ_AIC_SPDIF
	tristate
	select SND_ASOC_JZ_AIC

config SND_ASOC_JZ_AIC_I2S
	tristate
	select SND_ASOC_JZ_AIC

config SND_ASOC_JZ_PCM_DUMP_CDC
	tristate

config SND_ASOC_JZ_PCM
	tristate
	select SND_ASOC_JZ_PCM_DUMP_CDC

config SND_ASOC_JZ_SPDIF_DUMP_CDC
	tristate

config SND_ASOC_JZ_SPDIF
	tristate
	select SND_ASOC_JZ_SPDIF_DUMP_CDC

config SND_ASOC_JZ_ICDC_D1
	tristate
	select SND_ASOC_JZ_AIC
	select JZ_AIC_MASTER
	select SND_ASOC_JZ_INCODEC

config SND_ASOC_JZ_ICDC_D2
	tristate
	select SND_ASOC_JZ_AIC
	select SND_ASOC_JZ_INCODEC

config SND_ASOC_JZ_EXTCDC
	tristate
	select SND_ASOC_JZ_AIC

menu "jz board type select"
choice
	prompt "soc 4775 codec type select"
	depends on SOC_M200
	config SND_ASOC_INGENIC_DORADO_ICDC
	tristate "Audio support for dorado with internal codec"
	select SND_ASOC_JZ_AIC_I2S
	select SND_ASOC_JZ_ICDC_D1
	select SND_ASOC_JZ_PCM
	help
	  Say Y if you want to add audio support for M200 Dorado
	  reference board with internal codec
endchoice
choice
	prompt "soc 4775 codec type select"
	depends on SOC_4775
	config SND_ASOC_INGENIC_MENSA_ICDC
	bool "Audio support for mensa with internal codec"
	select SND_ASOC_JZ_AIC_I2S
	select SND_ASOC_JZ_ICDC_D2
	select SND_ASOC_JZ_PCM

	config SND_ASOC_INGENIC_MENSA_SPDIF
	bool "Audio support for mensa with spdif"
	select SND_ASOC_JZ_AIC_SPDIF
	select SND_ASOC_JZ_SPDIF
	select SND_ASOC_JZ_PCM
endchoice

config SND_ASOC_INGENIC_DMIC
	bool "Support DMIC for record"
	depends on SND_ASOC_JZ_INCODEC
endmenu

config JZ_ASOC_DMA_AUTO_CLR_DRT_MEM
	bool "JZ audio dma clear auto dirty memory"
	help
	  Say Y if you audio dma clear auto dirty memory, so you would not
	  clear by slience_threshold set by user app
config JZ_ASOC_DMA_HRTIMER_MODE
	bool "JZ audio dma cyclic dma with hrtimer callback mode"
	depends on HIGH_RES_TIMERS
	default n
	help
	  Say Y if you want suport sandard cyclic dma interface, Say N, that
	  dma cyclic interface is not standard
config JZ_ASOC_CODEC_HP_INSERT_REV
	bool "JZ headphone jack detect is Reversal"
	depends on SND_ASOC_JZ_ICDC_D1
	default n
	help
	  Say Y if you headphone jack detect is Reversal
endif
```
